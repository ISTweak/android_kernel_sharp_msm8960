## drivers/sharp/Kconfig
```kconfig
#
# SHARP configuration
#

menu "SHARP Device Drivers"

source "drivers/sharp/mfc/Kconfig"

source "drivers/sharp/shdiag/Kconfig"

source "drivers/sharp/tunerdrv/Kconfig"
source "drivers/sharp/tunerdrv_dl12/Kconfig"

#/*SH_AUDIO_DRIVER->*//*02-092*/
source "drivers/sharp/shaudio/Kconfig"
#/*SH_AUDIO_DRIVER<-*//*02-092*/

source "drivers/sharp/shbatt/Kconfig"

source "drivers/sharp/shtps/Kconfig"

source "drivers/sharp/shswic/Kconfig"
source "drivers/sharp/shmds/Kconfig"

source "drivers/sharp/proximity/Kconfig"

source "drivers/sharp/shirda/Kconfig"

source "drivers/sharp/presenter/Kconfig"

source "drivers/sharp/shterm/Kconfig"

source "drivers/sharp/shlog/Kconfig"

source "drivers/sharp/vold/Kconfig"

source "drivers/sharp/shtimer/Kconfig"

source "drivers/sharp/shmhl/Kconfig"

endmenu
```

## drivers/sharp/mfc/Kconfig
```kconfig
#
# FeliCa device configuration
#

menu "FeliCa driver"

comment "SHARP FeliCa device drivers"

config SHFELICA
	bool "FeliCa device drivers"
	depends on SERIAL_MSM_HSL && I2C
	default y
	help
	  Enable FeliCa driver.

config SHSNFC
	bool "NFC device drivers"
	depends on SHFELICA
	default n
	help
	  Enable NFC driver.

endmenu
```

## drivers/sharp/shbatt/Kconfig
```kconfig
#
# battely control configuration
#

menu "Battely Control"

comment "Battely Control Driver"

config PM_WIRELESS_CHARGE
	bool "SHARP Wireless Charger support"
	default n

endmenu
```

## drivers/sharp/shtps/Kconfig
```kconfig
#
# Sharp Touchscreen configuration
#

menuconfig TOUCHSCREEN_SHTPS
	bool "sharp touchscreens"
	default y

if TOUCHSCREEN_SHTPS

	config SHTPS_TMA4XX_DEV
		tristate "TMA4XX Device"
		default n
		depends on TOUCHSCREEN_SHTPS

	config SHTPS_TMA4XX_TMA443
		tristate "TMA4XX TMA443"
		default n
		depends on SHTPS_TMA4XX_DEV

	if SHTPS_TMA4XX_TMA443
		source "drivers/sharp/shtps/tma4xx/Kconfig"
	endif # SHTPS_TMA4XX_TMA443

	config SHTPS_TMA4XX_TMA463_001
		tristate "TMA4XX TMA463-001"
		default n
		depends on SHTPS_TMA4XX_DEV

	if SHTPS_TMA4XX_TMA463_001
		source "drivers/sharp/shtps/tma4xx/tma463-001/Kconfig"
	endif # SHTPS_TMA4XX_TMA463_001

	config SHTPS_TMA4XX_TMA463_002
		tristate "TMA4XX TMA463-002"
		default n
		depends on SHTPS_TMA4XX_DEV

	if SHTPS_TMA4XX_TMA463_002
		source "drivers/sharp/shtps/tma4xx/tma463-002/Kconfig"
	endif # SHTPS_TMA4XX_TMA463_002

	config SHTPS_TMA4XX_TMA463_003
		tristate "TMA4XX TMA463-003"
		default n
		depends on SHTPS_TMA4XX_DEV

	if SHTPS_TMA4XX_TMA463_003
		source "drivers/sharp/shtps/tma4xx/tma463-003/Kconfig"
	endif # SHTPS_TMA4XX_TMA463_003


	source "drivers/sharp/shtps/sy3000/Kconfig"

endif # TOUCHSCREEN_SHTPS
```

## drivers/sharp/shtps/sy3000/Kconfig
```kconfig
#
# Sharp Touchscreen configuration
#

if TOUCHSCREEN_SHTPS
	config SHTPS_SY3X00_DEV
		tristate "SY3x00 Device"
		default n
		depends on TOUCHSCREEN_SHTPS

	config SHTPS_SY3000_TM2187_001
		tristate "SY3000 TM2187_001"
		default n
		depends on SHTPS_SY3X00_DEV

	if SHTPS_SY3000_TM2187_001
		source "drivers/sharp/shtps/sy3000/tm2187-001/Kconfig"
	endif # SHTPS_SY3000_TM2187_001


	config SHTPS_SY3000_TM2153_001
		tristate "SY3000 TM2153-001"
		default n
		depends on SHTPS_SY3X00_DEV

	if SHTPS_SY3000_TM2153_001
		source "drivers/sharp/shtps/sy3000/tm2153-001/Kconfig"
	endif # SHTPS_SY3000_TM2153_001


	config SHTPS_SY3000_TM2215_001
		tristate "SY3000 TM2215-001"
		default n
		depends on SHTPS_SY3X00_DEV

	if SHTPS_SY3000_TM2215_001
		source "drivers/sharp/shtps/sy3000/tm2215-001/Kconfig"
	endif # SHTPS_SY3000_TM2215_001



endif # TOUCHSCREEN_SHTPS
```

## drivers/sharp/shtps/tma4xx/Kconfig
```kconfig
#
# Sharp Touchscreen tma443 configuration
#

config SHTPS_TMA4XX_FACETOUCH_DETECT
	bool "SHTPS_TMA4XX_FACETOUCH_DETECT"
	default n
	depends on SHTPS_TMA4XX_TMA443

config SHTPS_TMA4XX_FACETOUCH_OFF_DETECT
	bool "SHTPS_TMA4XX_FACETOUCH_OFF_DETECT"
	default n
	depends on SHTPS_TMA4XX_TMA443
```

## drivers/sharp/shtps/tma4xx/tma463-002/Kconfig
```kconfig
#
# Sharp Touchscreen tma463 configuration
#

config SHTPS_TMA4XX_FACETOUCH_DETECT
	bool "SHTPS_TMA4XX_FACETOUCH_DETECT"
	default n
	depends on SHTPS_TMA4XX_TMA463_002

config SHTPS_TMA4XX_FACETOUCH_OFF_DETECT
	bool "SHTPS_TMA4XX_FACETOUCH_OFF_DETECT"
	default n
	depends on SHTPS_TMA4XX_TMA463_002
```

## drivers/sharp/tunerdrv_dl12/Kconfig
```kconfig
# drivers/sharp/tunerdrv_dl12/Kconfig

menu "DTV Tuner Configuration (DL12)"

config DTV_TUNERDEV_DL12
	bool "set DTV tuner dev.(DL12)"
	default n


endmenu
```
